## arch/arm/mach-s5pc100/Kconfig
```kconfig
# arch/arm/mach-s5pc100/Kconfig
#
# Copyright 2008 Openmoko, Inc.
# Copyright 2008 Simtec Electronics
#
# Licensed under GPLv2

# Configuration options for the S5PC100 CPU

config CPU_S5PC100
	bool
	depends on ARCH_S5PC1XX
	select CPU_S5PC100_INIT
	select CPU_S5PC100_CLOCK
	help
	  Enable S5PC100 CPU support

config S5PC1XX_SETUP_SDHCI
        bool
        help
          Internal helper functions for S5PC1XX based SDHCI systems

config MACH_SMDKC100
	bool "SMDKC100"
	select CPU_S5PC100
	select S3C_DMA_PL330
	select S3C_DEV_I2C1
        select S3C_DEV_HSMMC
        select S3C_DEV_HSMMC1
        select S3C_DEV_HSMMC2
        select S5PC1XX_SETUP_SDHCI
	select S3C64XX_SETUP_I2C1
	help
	  Machine support for the Samsung SMDKC100

config MACH_HKDKC100
	bool "HKDKC100"
	select CPU_S5PC100
	select S3C_DMA_PL330
	select S3C_DEV_I2C1
        select S3C_DEV_HSMMC
        select S3C_DEV_HSMMC1
        select S3C_DEV_HSMMC2
        select S5PC1XX_SETUP_SDHCI
	select S3C64XX_SETUP_I2C1
	help
	  Machine support for the Hardkernel HKKC100

config MACH_UNIVERSAL
	bool "Universal"
	select CPU_S5PC100
	select S3C_DMA_PL330
	select S3C_DEV_I2C1
        select S3C_DEV_HSMMC
        select S3C_DEV_HSMMC1
        select S5PC1XX_SETUP_SDHCI
	select S3C64XX_SETUP_I2C1
	help
	  Machine support for the Samsung Universal

choice
	prompt "MMC/SD slot setup"
	depends on PLAT_S5PC1XX
	default S5PC100_SD_CH0_4BIT

config S5PC100_SD_CH0_4BIT
	bool "Use 4-bit bus with channel 0"
	help
		Select 4-bit bus for channel 0

config S5PC100_SD_CH0_8BIT
	bool "Use 8-bit bus with channel 0"
	help
		Select 8-bit bus for channel 0
endchoice
```

## drivers/media/video/samsung/fimc/Kconfig
```kconfig
config VIDEO_FIMC
	bool "Samsung Camera Interface (FIMC) driver"
	depends on VIDEO_SAMSUNG && (CPU_S5PC100 || CPU_S5PC110 || CPU_S5P6442)
	select VIDEO_IPC if CPU_S5PC110
	default n
	---help---
	  This is a video4linux driver for Samsung FIMC device.

config VIDEO_IPC
	bool

config VIDEO_FIMC_DEBUG
	bool "FIMC driver debug messages"
	depends on VIDEO_FIMC

config VIDEO_FIMC_MIPI
	bool "MIPI-CSI2 Slave Interface support"
	depends on VIDEO_FIMC && (CPU_S5PC100 || CPU_S5PC110)

choice
depends on VIDEO_FIMC
prompt "Select Output Mode"
default VIDEO_FIMC_DMA_AUTO 
config VIDEO_FIMC_DMA_AUTO
        bool "DMA ATUO MODE"
        depends on VIDEO_FIMC
        ---help---
          This enables support for FIMC1 DMA AUTO mode

config VIDEO_FIMC_FIFO
        bool "FIFO MODE"
        depends on VIDEO_FIMC
        ---help---
          This enables support for FIMC1 FIFO mode

endchoice
```

## drivers/media/video/samsung/fimc_6410/Kconfig
```kconfig
config VIDEO_FIMC
	bool "Samsung Camera Interface (FIMC) driver"
	depends on VIDEO_SAMSUNG && (CPU_S3C6410 || CPU_S5PC100 || CPU_S5PC110 || CPU_S5P6442)
	select VIDEO_IPC if CPU_S5PC110
	default n
	---help---
	  This is a video4linux driver for Samsung FIMC device.

config VIDEO_IPC
	bool

config VIDEO_FIMC_DEBUG
	bool "FIMC driver debug messages"
	depends on VIDEO_FIMC

config VIDEO_FIMC_MIPI
	bool "MIPI-CSI2 Slave Interface support"
	depends on VIDEO_FIMC && (CPU_S3C6410 || CPU_S5PC100 || CPU_S5PC110)
```

## drivers/media/video/samsung/gvg/Kconfig
```kconfig
#
# Configuration for FIMG-VG
#

config VIDEO_GVG
	bool "Samsung FIMG-VG Driver" 
	depends on VIDEO_SAMSUNG && CPU_S5P6440
	default n
	---help---
	  This is a FIMG-VG(OpenVG accelerator) driver for Samsung S5P6440.
```

## drivers/media/video/samsung/rotator/Kconfig
```kconfig
#
# Configuration for rotator
#

config VIDEO_ROTATOR
	bool "Samsung Image Rotator Driver" 
	depends on VIDEO_SAMSUNG && (CPU_S3C6410 || CPU_S5PC100 || CPU_S5PC110 || CPU_S5P6442)
	default n
	---help---
	  This is a Rotator for Samsung S3C6410, S5PC100 and S5PC110.
```

## sound/soc/s3c/Kconfig
```kconfig
config SND_S3C64XX_SOC
	tristate "Samsung SoC Audio"
	depends on ARCH_S3C64XX
	help
	  Say Y or M if you want to add support for codecs attached to
	  the S3C AC97, I2S or SSP interface. You will also need
	  to select the audio interfaces to support below.

config SND_S5P_SOC
	tristate "Samsung SoC Audio"
	depends on ARCH_S5PC1XX || ARCH_S5PC11X || ARCH_S5P64XX
	help
	  Say Y or M if you want to add support for codecs attached to
	  the S3C AC97, I2S or SSP interface. You will also need
	  to select the audio interfaces to support below.

config SND_S3C_I2S_V32
	tristate

config SND_S3C_I2S_V40
	tristate

config SND_S3C_I2S_V50
	tristate

config SND_S3C_AC97
	tristate

config SND_S5P_SPDIF
	tristate
	
choice
	prompt "Select the codec driver"
	depends on SND_S3C64XX_SOC || SND_S5P64XX_SOC || SND_S5PC1XX_SOC

config  SND_SMDK6410_WM8580
	tristate "WM8580-I2S on SMDK6410"
	depends on SND_S3C64XX_SOC
	select SND_S3C_I2S_V40
	select SND_SOC_WM8580


endchoice

choice
	prompt "Select the codec driver"
	depends on SND_S5P_SOC

config  SND_SMDKC110_WM8580
	tristate "WM8580-I2S on SMDKC110"
	depends on ARCH_S5PC11X
	select SND_S3C_I2S_V50
	select SND_SOC_WM8580

config  SND_SMDKC100_WM8580
	tristate "WM8580-I2S on SMDKC100"
	depends on ARCH_S5PC1XX
	select SND_S3C_I2S_V50
	select SND_SOC_WM8580

config  SND_SMDKC100_S5M8751
	tristate "S5M8751-I2S on SMDKC100"
	depends on ARCH_S5PC1XX
	select SND_S3C_I2S_V32
	select SND_SOC_S5M8751

config  SND_SMDKC100_WM9713
	tristate "WM9713-AC97 on SMDKC100"
	depends on ARCH_S5PC1XX
	select SND_S3C_AC97
	select SND_SOC_WM9713

config SND_S5PC100_SOC_UNIVERSAL_AK4671
	tristate "SoC I2S Audio support for UNIVERSAL - AK4671"
	depends on ARCH_S5PC1XX
	select SND_S3C_I2S_V50
	select SND_SOC_AK4671
	select SND_SOC_MAX9877
	help
	  Say Y if you want to add support for SoC audio on universal
	  with the AK4671.

config  SND_SMDK6442_WM8580
	tristate "WM8580-I2S on SMDK6442"
	depends on ARCH_S5P64XX
	select SND_S3C_I2S_V50
	select SND_SOC_WM8580

config SND_SMDKC110_HDMI_SPDIF
	tristate "HDMI-SPDIF on SMDKC110"
	depends on ARCH_S5PC11X
	select SND_S5P_SPDIF
	
config SND_SMDKC100_HDMI_SPDIF
	tristate "HDMI-SPDIF on SMDKC100"
	depends on ARCH_S5PC1XX
	select SND_S5P_SPDIF
	
endchoice

config  SND_WM8580_MASTER
	bool "WM8580 Codec is I2S Master"
	depends on SND_SMDKC110_WM8580 || SND_SMDKC100_WM8580 || SND_SMDK6442_WM8580
	default y
	help
	  Say Y if you want to run SoC as I2S-Slave and CODEC as I2S-Master.

config  S5P_USE_CLKAUDIO
	bool "Use CLKAUDIO"
	depends on !SND_WM8580_MASTER && (SND_SMDKC110_WM8580 || SND_SMDKC100_WM8580 || SND_SMDK6442_WM8580)
	default y
	help
	  Say Y if you want to generate I2S signals(LRCLK and BCLK) from CLKAUDIO.
	  Do not select it for SoC I2S-Slave mode.
	  If this is not selected in SoC I2S-Master mode, then PCLK will be used to
	  generate(LRCLK and BCLK) signals.
```

## sound/soc/s3c24xx/Kconfig
```kconfig
config SND_SAMSUNG_SOC
	tristate "Samsung SoC Audio Drivers"
	depends on ARCH_S5PC1XX || ARCH_S5PC11X || ARCH_S5P64XX
	help
	  Say Y or M if you want to add support for codecs attached to
	  the Samsung AC97, I2S or SSP interface. You will also need
	  to select the audio interfaces to support below.

config SND_S3C24XX_SOC
	tristate

config SND_LPAM_SOC
	tristate

config SND_S3C24XX_SOC_I2S
	tristate

config SND_S3C_I2SV2_SOC
	tristate

config SND_S3C2412_SOC_I2S
	tristate

config SND_S5P_SOC_I2S
	tristate
	select SND_S3C_I2SV2_SOC

config SND_S5P_SOC_I2S_LP
	tristate

config SND_S3C2443_SOC_AC97
	tristate
	select AC97_BUS
	select SND_SOC_AC97_BUS

config SND_S5P_SOC_AC97
	tristate
	select AC97_BUS
	select SND_SOC_AC97_BUS

config SND_S3C_SOC_PCM
	tristate

config SND_S5P_SPDIF
	tristate

config SND_ODROID_SPDIF
	tristate
	
config SND_S5P_SOC_WM8991
	tristate "SoC Audio support for WM8991 on ODROID"
	depends on SND_SAMSUNG_SOC && (MACH_SMDKC110 || MACH_SMDKC100 || MACH_HKDKC100)
	select SND_S3C24XX_SOC
	select SND_ODROID_SPDIF
	select SND_S5P_SOC_I2S
	select SND_SOC_WM8991
	help
	  Sat Y if you want to add support for SoC audio on the SMDKS5P.

choice
    prompt "WM8991 I2C Connection Select"
	depends on SND_S5P_SOC_WM8991

config SND_S5PC100_GPIO_I2C
	bool "ODROID WM8991 I2C Connection GPIO"
	depends on SND_S5P_SOC_WM8991
	help
	  Say Y here to make i2c line as GPIO.

config SND_S5PC100_SMBUS_I2C
	bool "ODROID WM8991 I2C Connection SMBUS"
	depends on SND_S5P_SOC_WM8991
	help
	  Say Y here to make i2c line as SMBUS.
endchoice

config SND_S5P_SOC_WM8580
	tristate "SoC Audio support for WM8580 on SMDK-S5P"
	depends on SND_SAMSUNG_SOC && (MACH_SMDKC110 || MACH_SMDKC100)
	select SND_S3C24XX_SOC
	select SND_SOC_WM8580
	help
	  Sat Y if you want to add support for SoC audio on the SMDKS5P.

choice
	prompt "Select SMDK/WM8580 Audio Port Type"
	depends on SND_S5P_SOC_WM8580 && (MACH_SMDKC110 || MACH_SMDKC100)

config	SND_S5P_SMDK_WM8580_I2S_I2S
	bool "Primary : I2S, Secondary : I2S"
	select SND_S5P_SOC_I2S
	select SND_S3C_I2SV2_SOC

config	SND_S5P_SMDK_WM8580_I2S_PCM
	bool "Primary : I2S, Secondary : PCM"
	select SND_S5P_SOC_I2S
	select SND_S3C_SOC_PCM

endchoice

config SND_S5P_SOC_WM8580_LP
	tristate "SoC Audio support for WM8580 on SMDK-S5P in LPAM"
	depends on SND_SAMSUNG_SOC && (MACH_SMDKC110 || MACH_SMDKC100)
	depends on !SND_S3C24XX_SOC
	select SND_LPAM_SOC
	select SND_S5P_SOC_I2S_LP
	select SND_SOC_WM8580
	help
	  Sat Y if you want to add support for SoC audio on the SMDKS5P.

config SND_WM8580_MASTER
	bool "WM8580 Codec is I2S Master"
	depends on SND_S5P_SOC_WM8580
	default n
	help
	  Say Y if you want to run SoC as I2S-Slave and CODEC as I2S-Master.

config SND_S5P_USE_XCLK_OUT
	bool
	depends on MACH_SMDKC110 && SND_S5P_SOC_WM8580
	default y

config  S5P_USE_CLKAUDIO
	bool
	depends on SND_S5P_SOC_WM8580_LP && !SND_WM8580_MASTER
	default y

config SND_S3C24XX_SOC_NEO1973_WM8753
	tristate "SoC I2S Audio support for NEO1973 - WM8753"
	depends on SND_SAMSUNG_SOC && MACH_NEO1973_GTA01
	select SND_S3C24XX_SOC
	select SND_S3C24XX_SOC_I2S
	select SND_SOC_WM8753
	help
	  Say Y if you want to add support for SoC audio on smdk2440
	  with the WM8753.

config SND_S3C24XX_SOC_SMDK2443_WM9710
	tristate "SoC AC97 Audio support for SMDK2443 - WM9710"
	depends on SND_SAMSUNG_SOC && MACH_SMDK2443
	select SND_S3C24XX_SOC
	select SND_S3C2443_SOC_AC97
	select SND_SOC_AC97_CODEC
	help
	  Say Y if you want to add support for SoC audio on smdk2443
	  with the WM9710.

config SND_S3C24XX_SOC_LN2440SBC_ALC650
	tristate "SoC AC97 Audio support for LN2440SBC - ALC650"
	depends on SND_SAMSUNG_SOC
	select SND_S3C24XX_SOC
	select SND_S3C2443_SOC_AC97
	select SND_SOC_AC97_CODEC
	help
	  Say Y if you want to add support for SoC audio on ln2440sbc
	  with the ALC650.

config SND_S3C24XX_SOC_S3C24XX_UDA134X
	tristate "SoC I2S Audio support UDA134X wired to a S3C24XX"
       	depends on SND_SAMSUNG_SOC
	select SND_S3C24XX_SOC
       	select SND_S3C24XX_SOC_I2S
       	select SND_SOC_UDA134X

config SND_S5P_SOC_SMDK_WM9713
	tristate "SoC AC97 Audio support for SMDKS5P - WM9713"
	depends on SND_SAMSUNG_SOC && (MACH_SMDKC110 || MACH_SMDKC100)
	select SND_S3C24XX_SOC
	select SND_S5P_SOC_AC97
	select SND_SOC_AC97_CODEC
	select SND_SOC_WM9713
	help
	  Say Y if you want to add support for SoC audio on smdks5p
	  with the WM9713.

config SND_S5PC100_SOC_UNIVERSAL_AK4671
	tristate "SoC I2S Audio support for UNIVERSAL - AK4671"
	depends on SND_SAMSUNG_SOC && MACH_UNIVERSAL
	select SND_S3C24XX_SOC
	select SND_S5P_SOC_I2S
	select SND_SOC_AK4671
	select SND_SOC_MAX9877
	help
	  Say Y if you want to add support for SoC audio on universal
	  with the AK4671.

config SND_SMDKS5P_HDMI_SPDIF
	tristate "HDMI-SPDIF on SMDKS5P"
	depends on SND_SAMSUNG_SOC && (MACH_SMDKC110 || MACH_SMDKC100 || MACH_HKDKC100)
	select SND_S3C24XX_SOC
	select SND_S5P_SPDIF
```
